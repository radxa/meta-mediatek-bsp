// SPDX-License-Identifier: GPL-2.0
/*
 * Copyright (c) 2021 Baylibre, SAS
 * Author: Florian Sylvestre <florian.sylvestre@baylibre.com>
 */

#include "camera-ap1302-ar0430-dual.dtsi"

/ {
	fragment@7 {
		target = <&i2c3>;
		__overlay__ {
			camera@3d {
				status = "disabled";
			};
		};
	};

        fragment@8 {
                target = <&camsv2>;
                __overlay__ {
                        status = "disabled";
                };
        };

};
