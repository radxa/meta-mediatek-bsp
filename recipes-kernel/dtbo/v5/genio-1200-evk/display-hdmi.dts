/dts-v1/;
/plugin/;

/ {
	fragment@0 {
		target = <&dsi0>;
		__overlay__ {
			status = "disabled";
		};
	};

	fragment@1 {
		target = <&mipi_tx0>;
		__overlay__ {
			status = "disabled";
		};
	};

	fragment@2 {
		target = <&backlight_lcd0>;
		__overlay__ {
			status = "disabled";
		};
	};

	fragment@3 {
		target = <&disp_pwm0>;
		__overlay__ {
			status = "disabled";
		};
	};
};
