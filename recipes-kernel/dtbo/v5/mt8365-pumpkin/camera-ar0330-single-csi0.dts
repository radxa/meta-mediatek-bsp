// SPDX-License-Identifier: GPL-2.0

#include "camera-ar0330-dual.dtsi"

/ {
	fragment@7 {
		target = <&i2c3>;
		__overlay__ {
			sensor@10 {
				status = "disabled";
			};
		};
	};

	fragment@8 {
		target = <&camsv2>;
		__overlay__ {
			status = "disabled";
		};
	};
};
