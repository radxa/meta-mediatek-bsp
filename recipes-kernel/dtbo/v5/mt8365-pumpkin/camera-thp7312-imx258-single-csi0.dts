// SPDX-License-Identifier: GPL-2.0

#include "camera-thp7312-imx258-dual.dtsi"

/ {
	fragment@6 {
		target = <&i2c2>;
		__overlay__ {
			camera@61 {
				status = "disabled";
			};
		};
	};

	fragment@7 {
		target = <&camsv2>;
		__overlay__ {
			status = "disabled";
		};
	};
};
