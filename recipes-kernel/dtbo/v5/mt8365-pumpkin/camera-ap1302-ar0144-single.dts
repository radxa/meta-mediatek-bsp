// SPDX-License-Identifier: GPL-2.0
/*
 * Copyright (c) 2022 Baylibre, SAS
 * Author: Florian Sylvestre <fsylvestrebaylibre.com>
 */

#include "camera-ap1302-ar0144-dual.dtsi"

/ {
        fragment@5 {
                target = <&i2c2>;
                __overlay__ {
                        camera@3c {
                                sensors {
                                        sensor@1 {
                                                status = "disabled";
                                        };
                                };
                        };
                };
        };
};
