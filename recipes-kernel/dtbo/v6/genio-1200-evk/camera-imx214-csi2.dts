// SPDX-License-Identifier: GPL-2.0
/*
 * Copyright (c) 2022 MediaTek Inc.
 *
 */

/dts-v1/;
/plugin/;

#include "camera-common.dtsi"

/ {
	fragment@11 {
		target = <&i2c1>;
		__overlay__ {
			sensor2 {
				sensor-names = "imx214_mipi_raw";
				reg = <0x1a>;
				status = "okay";
			};
		};
	};

	fragment@12 {
		target = <&seninf_csi_port_2>;
		__overlay__ {
			status = "okay";
		};
	};

	fragment@13 {
		target = <&mtkcam0>;
		__overlay__ {
			status = "okay";
		};
	};
};
