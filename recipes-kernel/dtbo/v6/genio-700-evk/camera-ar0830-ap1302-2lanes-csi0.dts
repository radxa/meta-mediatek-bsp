// SPDX-License-Identifier: GPL-2.0
/*
 * Copyright (c) 2023 MediaTek Inc.
 *
 */

/dts-v1/;
/plugin/;

#include "camera-ar0830-ap1302-csi0.dts"

/ {
	fragment@13 {
		target = <&i2c5>;
		__overlay__ {
			sensor0 {
				sensor-names = "ar0830ap1302d2l_mipi_yuv";

				port {
					endpoint {
						data-lanes = <1 2>;
					};
				};

			};
		};
	};
};
