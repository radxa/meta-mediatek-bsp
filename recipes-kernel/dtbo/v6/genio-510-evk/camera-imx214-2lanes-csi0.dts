// SPDX-License-Identifier: GPL-2.0
/*
 * Copyright (c) 2023 MediaTek Inc.
 *
 */

/dts-v1/;
/plugin/;

#include "camera-imx214-csi0.dts"

/ {
	fragment@13 {
		target = <&i2c5>;
		__overlay__ {
			sensor0 {
				sensor-names = "imx214d2l_mipi_raw";

				port {
					endpoint {
						data-lanes = <1 2>;
					};
				};

			};
		};
	};
};
