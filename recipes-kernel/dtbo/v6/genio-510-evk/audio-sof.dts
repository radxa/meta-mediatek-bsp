/dts-v1/;
/plugin/;

/ {
	fragment@0 {
		target = <&adsp>;
		__overlay__ {
			status = "okay";
		};
	};

	fragment@1 {
		target = <&sound>;
		__overlay__ {
			mediatek,adsp = <&adsp>;
			mediatek,dai-link = "DL_SRC_BE", "UL_SRC_BE", "DMIC_BE", "ETDM3_OUT_BE",
					    "DPTX_BE", "AFE_SOF_DL2", "AFE_SOF_DL3", "AFE_SOF_UL4",
					    "AFE_SOF_UL5";
		};
	};
};
