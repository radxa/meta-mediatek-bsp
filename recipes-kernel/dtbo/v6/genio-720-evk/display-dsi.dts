/dts-v1/;
/plugin/;

/ {
	fragment@0 {
		target = <&mipi_tx_config0>;
		__overlay__ {
			status = "okay";
		};
	};

	fragment@1 {
		target = <&dsi0>;
		__overlay__ {
			status = "okay";
			panel@0 {
				status = "okay";
			};
		};
	};
};
