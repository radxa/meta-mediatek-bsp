// SPDX-License-Identifier: GPL-2.0
/*
 * Copyright (c) 2025 MediaTek Inc.
 *
 */

#include "camera-ag190h-max96724-dual-std.dts"

/ {
	fragment@12 {
		target = <&i2c7>;
		__overlay__ {
			gmsl-deserializer@27 {
				status = "disabled";
			};
		};
	};

	fragment@13 {
		target = <&seninf_csi_port_0>;
		__overlay__ {
			status = "disabled";
		};
	};

	fragment@14 {
		target = <&mipi_csi0>;
		__overlay__ {
			status = "disabled";
		};
	};
};
