// SPDX-License-Identifier: GPL-2.0
/*
 * Copyright (c) 2024 MediaTek Inc.
 *
 */

#include "camera-ar0430-dual.dtsi"

/ {
	fragment@9 {
		target = <&i2c2>;
		__overlay__ {
			sensor@36 {
				status = "disabled";
			};
		};
	};

	fragment@10 {
		target = <&camsv1>;
		__overlay__ {
			status = "disabled";
		};
	};

	fragment@11 {
		target = <&mipi_csi0>;
		__overlay__ {
			status = "disabled";
		};
	};
};
