## conf/machine/include/mediatek-common.inc
```bitbake
MACHINEOVERRIDES =. "mtk:"

# Kernel
KERNEL_CLASSES = "kernel-fitimage"
KERNEL_IMAGETYPE = "${@bb.utils.contains('MACHINE_FEATURES', 'efi', 'Image.gz', 'fitImage', d)}"
KERNEL_IMAGETYPES:append = "${@bb.utils.contains('MACHINE_FEATURES', 'efi', ' fitImage', '', d)}"

KERNEL_COMPRESSION = "gzip"

# U-Boot
UBOOT_SUFFIX = "bin"
UBOOT_ENTRYPOINT       = "0x64000000"
UBOOT_LOADADDRESS      = "0x64000000"
UBOOT_DTB_LOADADDRESS  = "0x44000000"
UBOOT_DTBO_LOADADDRESS = "0x44c00000"
UBOOT_SIGN_ENABLE = "${@bb.utils.contains('DISTRO_FEATURES', 'secure-boot', '1', '0', d)}"

# OP-TEE OS
PREFERRED_PROVIDER_virtual/optee-os ?= "optee-os"
PREFERRED_VERSION_optee-client ?= "3.19"
PREFERRED_VERSION_optee-examples ?= "3.19"
PREFERRED_VERSION_optee-os ?= "3.19"
PREFERRED_VERSION_optee-os-tadevkit ?= "3.19"
PREFERRED_VERSION_optee-test ?= "3.19"
OPTEE_TZDRAM_START ?= "0x43200000"
OPTEE_TZDRAM_SIZE  ?= "0x00a00000"

def get_devicetree_basename(paths):
    import os
    tmp = []
    for p in paths.split(" "):
        tmp.append(os.path.basename(p))
    return " ".join(tmp)

IMAGE_BOOT_FILES = " \
	${KERNEL_IMAGETYPE} \
	${@bb.utils.contains('KERNEL_IMAGETYPE', 'fitImage', '', get_devicetree_basename("${KERNEL_DEVICETREE}"), d)} \
"

SERIAL_CONSOLES = "921600;ttyS0"

WKS_FILE ?= "mediatek-bootimg.wks"
WIC_SECTOR_SIZE ?= "512"
WIC_BLOCK_SIZE ?= "1024"
WICVARS:append = " WIC_SECTOR_SIZE WIC_BLOCK_SIZE"
do_image_wic[depends] += " \
	trusted-firmware-a:do_deploy \
	virtual/kernel:do_deploy \
"

PREFERRED_PROVIDER_virtual/dtb = "dtbo"
PREFERRED_VERSION_dtbo = "${@'6' if d.getVar('PREFERRED_VERSION_linux-mtk').startswith('6') else '5'}"

PREFERRED_PROVIDER_virtual/kernel ?= "linux-mtk"
PREFERRED_PROVIDER_virtual/bootloader ?= "u-boot"
PREFERRED_PROVIDER_virtual/lk ?= "${@bb.utils.contains("DISTRO_FEATURES", "nda-mtk", "lk", "lk-prebuilt", d)}"
PREFERRED_PROVIDER_virtual/bl2 ?= "bl2"

PREFERRED_VERSION_linux-mtk ??= "6.6%"

EXTRA_IMAGEDEPENDS = " \
	virtual/lk \
	${@bb.utils.contains("DISTRO_FEATURES", "security", "", "trusted-firmware-a", d)} \
	rity-tools \
"

MACHINE_ESSENTIAL_EXTRA_RDEPENDS += "kernel-image"

MACHINE_EXTRA_RRECOMMENDS += " \
	kernel-modules \
"

# Set this only for factory image
# An image built with this option should not be shipped to customers
OPTEE_RPMB_WRITE_KEY ??= "0"
# Set this only to use the RPMB test key instead of generating an unique one
OPTEE_RPMB_TEST_KEY ??= "0"

MACHINE_EXTRA_RRECOMMENDS:append = " ${@bb.utils.contains("DISTRO_FEATURES", "optee-otp", " optee-otp", "", d)}"

# Set this to enable AB boot on fwupdate supported
AB_FWUPDATE_ENABLE ?= "${@bb.utils.contains("DISTRO_FEATURES", "fwupdate", "1", "0", d)}"
# Set this to sign BL2 and support DAA
BL2_SIGN_ENABLE ??= "0"
DA_SIGN_ENABLE ??= "0"

FIT_SIGN_INDIVIDUAL ?= "${@bb.utils.contains("DISTRO_FEATURES", "secure-boot", "1", "0", d)}"
FIT_GENERATE_KEYS ?= "${@bb.utils.contains("DISTRO_FEATURES", "secure-boot", "1", "0", d)}"
UBOOT_SIGN_KEYDIR ?= "${@bb.utils.contains("DISTRO_FEATURES", "secure-boot", "${DEPLOY_DIR_IMAGE}/secure", "", d)}"
UBOOT_SIGN_KEYNAME ?= "${@bb.utils.contains("DISTRO_FEATURES", "secure-boot", "u-boot", "", d)}"
UBOOT_SIGN_IMG_KEYNAME ?= "${@bb.utils.contains("DISTRO_FEATURES", "secure-boot", "u-boot-img", "", d)}"
FIT_SIGN_NUMBITS ?= "3072"
FIT_SIGN_ALG ?= "rsa3072"
UBOOT_FIT_SIGN_NUMBITS ?= "3072"
UBOOT_FIT_SIGN_ALG ?= "rsa3072"

# Set this to enable rootfs security for verity image
DM_VERITY_IMAGE ?= "${IMAGE_BASENAME}"
DM_VERITY_IMAGE_TYPE ?= "ext4"

# Allowed license for mtk device - overrideable if necessary
MTK_EXTRA_LICENSE_FLAGS_ACCEPTED ?= "commercial"

# Packages requiring extra licenses
LICENSE_FLAGS_ACCEPTED:append:pn-libmali = " ${MTK_EXTRA_LICENSE_FLAGS_ACCEPTED}"

# Set this for MediaTek camera ISP dependencies
PREFERRED_VERSION_glog ?= "0.5.0"

# Set this for Libcamera
PREFERRED_VERSION_libcamera ?= "0.3.0"
```

## conf/machine/include/mt7925.inc
```bitbake
MACHINEOVERRIDES =. "mt7925:"

MACHINE_EXTRA_RRECOMMENDS:append = " \
	${@bb.utils.contains("DISTRO_FEATURES", "wifi", "kernel-module-mt7925e linux-firmware-mt7925", "", d)} \
"
```

## conf/machine/include/mt8167.inc
```bitbake
require conf/machine/include/arm/armv8a/tune-cortexa35.inc
require conf/machine/include/soc-family.inc
require mediatek-common.inc

SOC_FAMILY = "mt8167"

# Trusted Firmware-A
PREFERRED_PROVIDER_virtual/bl2 = "bl2-prebuilt"

# OP-TEE
OPTEE_TARGET = "mediatek-mt8516"
OPTEE_DRAM_SIZE = "0x80000000"

# LK
LK_PROJECT = "pumpkin8516-emmc"

MACHINE_FEATURES:append = " optee"
DISTRO_FEATURES:remove = " x11 "

IMGTEC_VERSION ??= "1.13@5776728"
IMGTEC_FW ??= "rgx.fw.22.40.54.30"
IMGTEC_SH ??= "rgx.sh.22.40.54.30"

MACHINE_EXTRA_RRECOMMENDS:append = " \
	imgtec-pvr \
"

PREFERRED_PROVIDER_virtual/egl ?= "imgtec-pvr"
PREFERRED_PROVIDER_virtual/libegl ?= "imgtec-pvr"
PREFERRED_PROVIDER_virtual/libgbm ?= "imgtec-pvr"
PREFERRED_PROVIDER_virtual/libgl ?= "imgtec-pvr"
PREFERRED_PROVIDER_virtual/libgles2 ?= "imgtec-pvr"
PREFERRED_PROVIDER_virtual/mesa ?= "imgtec-pvr"
PREFERRED_PROVIDER_virtual/opencl ?= "imgtec-pvr"

VIRTUAL-RUNTIME_mdpd ??= "${@bb.utils.contains("DISTRO_FEATURES", "nda-mtk", "mtk-mdpd", "mdpd-prebuilt", d)}"

MACHINEOVERRIDES =. "mt8362:mt8362a:i300:i300a:"
```

## conf/machine/include/mt8188.inc
```bitbake
require conf/machine/include/arm/arch-armv8a.inc
require conf/machine/include/soc-family.inc
require mediatek-common.inc

SOC_FAMILY = "mt8188"
SOC_SRAM_ADDR = "0x201000"

# Trusted Firmware-A
TFA_PLATFORM = "mt8188"

# OP-TEE
OPTEE_TARGET = "mediatek-mt8188"
OPTEE_DRAM_SIZE = "0x80000000"

# LK
LK_PROJECT = "mt8390-evk"

MACHINE_FEATURES:append = " optee"
MACHINE_FEATURES:append = " ${@bb.utils.contains("DISTRO_FEATURES", "nda-mtk", "optee-efuse", "", d)}"

# Mali
require gpu-provider.inc
MALI_SOC = "mt8188"

MACHINE_EXTRA_RRECOMMENDS:append = " \
	linux-firmware-mt8188-scp \
	linux-firmware-mt8188-sof \
	${@bb.utils.contains("MACHINE_FEATURES", "optee-efuse", "optee-ewriter", "", d)} \
"

MACHINEOVERRIDES =. "mt8390:genio-700:"
```

## conf/machine/include/mt8195.inc
```bitbake
require conf/machine/include/arm/arch-armv8a.inc
require conf/machine/include/soc-family.inc
require mediatek-common.inc

SOC_FAMILY = "mt8195"
SOC_SRAM_ADDR = "0x201000"

# Trusted Firmware-A
TFA_PLATFORM = "mt8195"

# OP-TEE
OPTEE_TARGET = "mediatek-mt8195"
OPTEE_DRAM_SIZE = "0x80000000"

# LK
LK_PROJECT = "mt8395-demo"

MACHINE_FEATURES:append = " optee"
MACHINE_FEATURES:append = " ${@bb.utils.contains("DISTRO_FEATURES", "nda-mtk", "optee-efuse", "", d)}"

# Mali
require gpu-provider.inc
MALI_SOC = "mt8195"

MACHINE_EXTRA_RRECOMMENDS:append = " \
	linux-firmware-mt8195-scp \
	linux-firmware-mt8195-sof \
	${@bb.utils.contains("MACHINE_FEATURES", "optee-efuse", "optee-ewriter", "", d)} \
"

MACHINEOVERRIDES =. "mt8395:i1200:genio-1200:"
```

## conf/machine/include/mt8365.inc
```bitbake
require conf/machine/include/arm/arch-armv8a.inc
require conf/machine/include/soc-family.inc
require mediatek-common.inc

SOC_FAMILY = "mt8365"
SOC_SRAM_ADDR = "0x201000"

# Trusted Firmware-A
TFA_PLATFORM = "mt8365"

# OP-TEE
OPTEE_TARGET = "mediatek-mt8175"
OPTEE_DRAM_SIZE = "0x80000000"

# LK
LK_PROJECT = "mt8365-pumpkin"

MACHINE_FEATURES:append = " optee"
MACHINE_FEATURES:append = " ${@bb.utils.contains("DISTRO_FEATURES", "nda-mtk", "optee-efuse", "", d)}"

# Mali
require gpu-provider.inc
MALI_SOC = "mt8365"

MACHINE_EXTRA_RRECOMMENDS:append = " \
	linux-firmware-mt8365-sof \
	${@bb.utils.contains("MACHINE_FEATURES", "optee-efuse", "optee-ewriter", "", d)} \
"

VIRTUAL-RUNTIME_mdpd ?= "${@bb.utils.contains("DISTRO_FEATURES", "nda-mtk", "mtk-mdpd", "mdpd-prebuilt", d)}"

MACHINEOVERRIDES =. "i350:genio-350:"
```

## conf/machine/include/mt8367.inc
```bitbake
require conf/machine/include/arm/arch-armv8a.inc
require conf/machine/include/soc-family.inc
require mediatek-common.inc

SOC_FAMILY = "mt8367"
SOC_SRAM_ADDR = "0x2001000"

# Trusted Firmware-A
TFA_PLATFORM = "mt8391"

# OP-TEE
OPTEE_TARGET = "mediatek-mt8391"
OPTEE_DRAM_SIZE = "0x80000000"

# LK
LK_PROJECT = "mt8391-evk"

MACHINE_FEATURES:append = " optee"
MACHINE_FEATURES:append = " ${@bb.utils.contains("DISTRO_FEATURES", "nda-mtk", "optee-efuse", "", d)}"

# Mali
require gpu-provider.inc
MALI_SOC = "mt8189"

# Temporarily removed:
#	linux-firmware-mt8188-scp
#	linux-firmware-mt8188-sof
#	${@bb.utils.contains("MACHINE_FEATURES", "optee-efuse", "optee-ewriter", "", d)}
MACHINE_EXTRA_RRECOMMENDS:append = " \
"

MACHINEOVERRIDES =. "mt8367:genio-360:"
```

## conf/machine/mt8370-evk-norboot.conf
```bitbake
require include/mt8370.inc
require include/mt7921.inc
require include/mt7925.inc
require include/ubifs-macronix-mx25u25635F.inc

# Kernel
KERNEL_DEVICETREE = "mediatek/mt8370-genio-510-evk.dtb"

#U-Boot
UBOOT_MACHINE = "genio_510_evk_qspi_defconfig"

#FIXME libdram for nor support
LIBDRAM_BOARD_NAME = "genio-700-evk"

# OP-TEE
OPTEE_DRAM_SIZE = "0x100000000"

#LK
LK_PROJECT = "mt8390-evk-norboot"
LK_BOARD_NAME = "genio-510-evk"

# Trusted Firmware-A
TFA_NOR_FIP_ADDR = "0x400000"
TFA_NOR_FIP_LENGTH = "0x400000"
TFA_NOR_DRAMK_ADDR = "0x1400000"
TFA_NOR_MISC_ADDR = "0x1480000"

OVERRIDES .= ":nor-boot"

MACHINE_FEATURES:append = " nor-boot"
MACHINE_FEATURES:append = " alsa bluetooth pci usbgadget usbhost wifi tsn uc-fde"

MACHINEOVERRIDES =. "mt8370-evk:genio-510-evk:mt8370-evk-norboot:genio-510-evk-norboot:"

# onsemi-firmware
ONSEMI_BOARD_NAME = "MediaTek_Genio"
MACHINE_EXTRA_RRECOMMENDS:append = " \
        onsemi-firmware-ap1302-ar0430 \
        onsemi-firmware-ap1302-ar0830 \
"
```

## conf/machine/mt8370-evk.conf
```bitbake
require include/mt8370.inc
require include/mt7921.inc

# Kernel
KERNEL_DEVICETREE = "mediatek/mt8370-genio-510-evk.dtb"


# U-Boot
UBOOT_MACHINE = "genio_510_evk_defconfig"

# libdram
LIBDRAM_BOARD_NAME = "genio-700-evk"

# OP-TEE
OPTEE_DRAM_SIZE = "0x100000000"

# LK
LK_BOARD_NAME = "genio-510-evk"

MACHINE_FEATURES:append = " alsa bluetooth pci usbgadget usbhost wifi tsn uc-fde"

MACHINEOVERRIDES =. "mt8370-evk:genio-510-evk:"

# onsemi-firmware
ONSEMI_BOARD_NAME = "MediaTek_Genio"
MACHINE_EXTRA_RRECOMMENDS:append = " \
        onsemi-firmware-ap1302-ar0430 \
        onsemi-firmware-ap1302-ar0830 \
"

# Drivers for external I2C device
MACHINE_EXTRA_RRECOMMENDS:append = " \
        ite-it6510-driver \
        lontium-lt6911-driver \
"
```

## conf/machine/mt8390-evk-norboot.conf
```bitbake
require include/mt8188.inc
require include/mt7921.inc
require include/ubifs-macronix-mx25u25635F.inc

# Kernel
KERNEL_DEVICETREE = "mediatek/mt8390-genio-700-evk.dtb"

#U-Boot
UBOOT_MACHINE = "genio_700_evk_qspi_defconfig"

#FIXME libdram for nor support
LIBDRAM_BOARD_NAME = "genio-700-evk"

# OP-TEE
OPTEE_DRAM_SIZE = "0x200000000"

#LK
LK_PROJECT = "mt8390-evk-norboot"
LK_BOARD_NAME = "${LIBDRAM_BOARD_NAME}"

# Trusted Firmware-A
TFA_NOR_FIP_ADDR = "0x400000"
TFA_NOR_FIP_LENGTH = "0x400000"
TFA_NOR_DRAMK_ADDR = "0x1400000"
TFA_NOR_MISC_ADDR = "0x1480000"

OVERRIDES .= ":nor-boot"

MACHINE_FEATURES:append = " nor-boot"
MACHINE_FEATURES:append = " alsa bluetooth pci usbgadget usbhost wifi tsn uc-fde"

MACHINEOVERRIDES =. "mt8188-evk:mt8390-evk:genio-700-evk:mt8390-evk-norboot:genio-700-evk-norboot:"

# onsemi-firmware
ONSEMI_BOARD_NAME = "MediaTek_Genio"
MACHINE_EXTRA_RRECOMMENDS:append = " \
        onsemi-firmware-ap1302-ar0430 \
        onsemi-firmware-ap1302-ar0830 \
"
```

## conf/machine/mt8390-evk.conf
```bitbake
require include/mt8188.inc
require include/mt7921.inc

# Kernel
KERNEL_DEVICETREE = "mediatek/mt8390-genio-700-evk.dtb"

# U-Boot
UBOOT_MACHINE = "genio_700_evk_defconfig"

# libdram
LIBDRAM_BOARD_NAME = "genio-700-evk"

# OP-TEE
OPTEE_DRAM_SIZE = "0x200000000"

# LK
LK_BOARD_NAME = "${LIBDRAM_BOARD_NAME}"

MACHINE_FEATURES:append = " alsa bluetooth pci usbgadget usbhost wifi tsn uc-fde"

MACHINEOVERRIDES =. "mt8188-evk:mt8390-evk:genio-700-evk:"

# onsemi-firmware
ONSEMI_BOARD_NAME = "MediaTek_Genio"
MACHINE_EXTRA_RRECOMMENDS:append = " \
        onsemi-firmware-ap1302-ar0430 \
        onsemi-firmware-ap1302-ar0830 \
"
```

## conf/machine/mt8391-evk-norboot-ufs.conf
```bitbake
require include/mt8391.inc
require include/mt7921.inc
require include/mt7925.inc
require include/ubifs-macronix-mx25u12832F.inc

# Kernel
KERNEL_DEVICETREE = "mediatek/mt8391-genio-720-evk.dtb"

#FIXME U-Boot for nor support
UBOOT_MACHINE = "genio_720_evk_ufs_qspi_defconfig"

#FIXME libdram for nor support
LIBDRAM_BOARD_NAME = "genio-720-evk"

# OP-TEE
OPTEE_DRAM_SIZE = "0x200000000"

# LK
LK_PROJECT = "mt8391-evk-norboot-ufs"
LK_BOARD_NAME = "${LK_PROJECT}"

# Trusted Firmware-A
TFA_NOR_FIP_ADDR = "0x200000"
TFA_NOR_FIP_LENGTH = "0x200000"
TFA_NOR_DRAMK_ADDR = "0xA00000"
TFA_NOR_MISC_ADDR = "0xA80000"

# UFS storage
WIC_SECTOR_SIZE = "4096"
WIC_BLOCK_SIZE = "4096"

OVERRIDES .= ":nor-boot"

MACHINE_FEATURES:append = " nor-boot ufs-system"
MACHINE_FEATURES:append = " efi"
MACHINE_FEATURES:append = " alsa bluetooth pci usbgadget usbhost wifi tsn uc-fde"

MACHINEOVERRIDES =. "mt8391-evk:genio-720-evk:mt8391-evk-norboot-ufs:genio-720-evk-norboot-ufs:"

# onsemi-firmware
ONSEMI_BOARD_NAME = "MediaTek_Genio"
MACHINE_EXTRA_RRECOMMENDS:append = " \
"
```

## conf/machine/mt8391-evk-ufs.conf
```bitbake
require include/mt8391.inc
require include/mt7921.inc

# Kernel
KERNEL_DEVICETREE = "mediatek/mt8391-genio-720-evk.dtb"

# U-Boot
UBOOT_MACHINE = "genio_720_evk_defconfig"

# libdram
LIBDRAM_BOARD_NAME = "genio-720-evk"

# OP-TEE
OPTEE_DRAM_SIZE = "0x200000000"

# LK
LK_BOARD_NAME = "${LIBDRAM_BOARD_NAME}"

# UFS storage
WIC_SECTOR_SIZE = "4096"
WIC_BLOCK_SIZE = "4096"
MACHINE_FEATURES:append = " ufs-boot ufs-system"

MACHINE_FEATURES:append = " alsa bluetooth pci usbgadget usbhost wifi tsn uc-fde"

MACHINEOVERRIDES =. "mt8391-evk:genio-720-evk:mt8391-evk-ufs:genio-720-evk-ufs:"

# onsemi-firmware
ONSEMI_BOARD_NAME = "MediaTek_Genio"
MACHINE_EXTRA_RRECOMMENDS:append = " \
"
```
