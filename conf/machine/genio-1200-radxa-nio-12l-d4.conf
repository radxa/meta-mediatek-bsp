## conf/machine/genio-1200-radxa-nio-12l-d4.conf
```bitbake
require include/mt8195.inc
require include/mt7921.inc

# Kernel
KERNEL_DEVICETREE = "mediatek/genio-1200-radxa-nio-12l.dtb"
LIST_DTBO = " gpu-mali.dtbo video.dtbo apusys.dtbo ddr-4g.dtbo"
BOOT_CONF = "\#conf-mediatek_genio-1200-radxa-nio-12l.dtb\#conf-gpu-mali.dtbo\#conf-video.dtbo\#conf-apusys.dtbo\#conf-ddr-4g.dtbo"

# U-Boot
UBOOT_MACHINE = "genio_1200_radxa_nio_12l_d4_defconfig"

# libdram
LIBDRAM_BOARD_NAME = "genio-1200-evk-ufs"

# OP-TEE
OPTEE_DRAM_SIZE = "0x200000000"

# LK
LK_PROJECT = "mt8395-evk-ufs"
LK_BOARD_NAME = "${LK_PROJECT}"

# UFS storage
WIC_SECTOR_SIZE = "4096"
WIC_BLOCK_SIZE = "4096"
MACHINE_FEATURES:append = " ufs-boot "

MACHINE_FEATURES:append = " alsa bluetooth pci usbgadget usbhost wifi tsn uc-fde"

MACHINEOVERRIDES =. "mt8395-evk:genio-1200-evk:mt8395-evk-ufs:genio-1200-evk-ufs:"
```

## conf/machine/include/mt7663.inc
```bitbake
MTK_WIRELESS_RELEASE ?= "alps-release-r0.mp5-aiot"
MTK_WIRELESS_CHIP = "MT7663"
MACHINEOVERRIDES =. "mt7663:"

MT7663_WIFI_USE_UPSTREAM_DRV ??= "${@bb.utils.contains('DISTRO_FEATURES', 'nda-mtk', '0', '1', d)}"

WIFI_OSS_PKGS = "kernel-module-mt7663s mt7663-service"
WIFI_NDA_PKGS = "kernel-module-mt7663-tk-wifi wifitest"
WIFI_PKGS = "${@bb.utils.contains('MT7663_WIFI_USE_UPSTREAM_DRV', '1', '${WIFI_OSS_PKGS}', '${WIFI_NDA_PKGS}', d)}"

MT7663_BT_USE_UPSTREAM_DRV ??= "${@bb.utils.contains('DISTRO_FEATURES', 'nda-mtk', '0', '1', d)}"

BT_OSS_PKGS = "kernel-module-btmtksdio linux-firmware-mt7663"
BT_NDA_PKGS = "kernel-module-mt7663-tk-bt mtk-bluetooth boots picus bt-vendor"
BT_PKGS = "${@bb.utils.contains('MT7663_BT_USE_UPSTREAM_DRV', '1', '${BT_OSS_PKGS}', '${BT_NDA_PKGS}', d)}"

MACHINE_EXTRA_RRECOMMENDS:append = " \
	${@bb.utils.contains('DISTRO_FEATURES', 'wifi', '${WIFI_PKGS}', '', d)} \
	${@bb.utils.contains('DISTRO_FEATURES', 'bluetooth', '${BT_PKGS}', '', d)} \
"
```

## conf/machine/mt8365-evk.conf
```bitbake
require include/mt8365.inc
require include/mt7663.inc

# Kernel
KERNEL_DEVICETREE = "mediatek/mt8365-evk.dtb"

# U-Boot
UBOOT_MACHINE = "genio_350_evk_defconfig"

# libdram
LIBDRAM_BOARD_NAME = "mt8365-sb35"

# OP-TEE
OPTEE_DRAM_SIZE = "0xc0000000"

# LK
LK_BOARD_NAME = "${LIBDRAM_BOARD_NAME}"

MACHINE_FEATURES:append = " alsa usbgadget usbhost wifi uc-fde"

MACHINEOVERRIDES =. "mt8365-evk:i350-evk:genio-350-evk:"

# onsemi-firmware
ONSEMI_BOARD_NAME = "MediaTek_Genio"

MACHINE_EXTRA_RRECOMMENDS:append = " \
        onsemi-firmware-ap1302-ar0430 \
"
```

## conf/machine/mt8395-evk-p1v1.conf
```bitbake
require include/mt8195.inc
require include/mt7921.inc

# Kernel
KERNEL_DEVICETREE = "mediatek/genio-1200-evk-p1v1.dtb"

# U-Boot
UBOOT_MACHINE = "genio_1200_evk_defconfig"

# libdram
LIBDRAM_BOARD_NAME = "mt8395-demo"

# OP-TEE
OPTEE_DRAM_SIZE = "0x200000000"

# LK
LK_BOARD_NAME = "${LIBDRAM_BOARD_NAME}"

MACHINE_FEATURES:append = " alsa bluetooth pci usbgadget usbhost wifi tsn uc-fde"

MACHINEOVERRIDES =. "mt8395-evk-p1v1:genio-1200-evk-p1v1:"

# onsemi-firmware
ONSEMI_BOARD_NAME = "MediaTek_Genio"
MACHINE_EXTRA_RRECOMMENDS:append = " \
        onsemi-firmware-ap1302-ar0430 \
        onsemi-firmware-ap1302-ar0830 \
"
```
