## conf/machine/mt8391-evk.conf
```bitbake
require include/mt8391.inc
require include/mt7921.inc
require include/mt7925.inc

# Kernel
KERNEL_DEVICETREE = "mediatek/mt8391-genio-720-evk.dtb"

# U-Boot
UBOOT_MACHINE = "genio_720_evk_defconfig"

# libdram
LIBDRAM_BOARD_NAME = "genio-720-evk"

# OP-TEE
OPTEE_DRAM_SIZE = "0x200000000"

# LK
LK_BOARD_NAME = "${LIBDRAM_BOARD_NAME}"

MACHINE_FEATURES:append = " alsa bluetooth pci usbgadget usbhost wifi tsn uc-fde"

MACHINEOVERRIDES =. "mt8391-evk:genio-720-evk:"

# onsemi-firmware
ONSEMI_BOARD_NAME = "MediaTek_Genio"
MACHINE_EXTRA_RRECOMMENDS:append = " \
"
```

## conf/machine/mt8395-evb-ufs.conf
```bitbake
require include/mt8195.inc

# Kernel
KERNEL_DEVICETREE = "mediatek/mt8195-evb-ufs.dtb"

# U-Boot
UBOOT_MACHINE = "mt8195_evb_ufs_defconfig"

# libdram
LIBDRAM_BOARD_NAME = "mt8395-demo"

# LK
LK_PROJECT = "mt8395-evb-ufs"
LK_BOARD_NAME = "${LIBDRAM_BOARD_NAME}"

# UFS storage
WIC_SECTOR_SIZE = "4096"
WIC_BLOCK_SIZE = "4096"
MACHINE_FEATURES:append = " ufs-boot ufs-system "

MACHINEOVERRIDES =. "mt8395-evb-ufs:i1200-evb-ufs:genio-1200-evb-ufs:"
```

## conf/machine/mt8395-evk-norboot-ufs.conf
```bitbake
require include/mt8195.inc
require include/mt7921.inc
require include/ubifs-macronix-mx25u25635F.inc

# Kernel
KERNEL_DEVICETREE = "mediatek/mt8395-genio-1200-evk-ufs.dtb"

#FIXME U-Boot for nor support
UBOOT_MACHINE = "genio_1200_evk_ufs_qspi_defconfig"

#FIXME libdram for nor support
LIBDRAM_BOARD_NAME = "genio-1200-evk-ufs"

# OP-TEE
OPTEE_DRAM_SIZE = "0x200000000"

# LK
LK_PROJECT = "mt8395-evk-norboot-ufs"
LK_BOARD_NAME = "${LK_PROJECT}"

# Trusted Firmware-A
TFA_NOR_FIP_ADDR = "0x400000"
TFA_NOR_FIP_LENGTH = "0x400000"
TFA_NOR_DRAMK_ADDR = "0x1400000"
TFA_NOR_MISC_ADDR = "0x1480000"

# UFS storage
WIC_SECTOR_SIZE = "4096"
WIC_BLOCK_SIZE = "4096"

OVERRIDES .= ":nor-boot"

MACHINE_FEATURES:append = " nor-boot ufs-system"
MACHINE_FEATURES:append = " alsa bluetooth pci usbgadget usbhost wifi tsn uc-fde"

MACHINEOVERRIDES =. "mt8395-evk:genio-1200-evk:mt8395-evk-norboot-ufs:genio-1200-evk-norboot-ufs:"
```

## conf/machine/mt8395-evk.conf
```bitbake
require include/mt8195.inc
require include/mt7921.inc
require include/mt7925.inc

# Kernel
KERNEL_DEVICETREE = "mediatek/mt8395-genio-1200-evk.dtb"

# U-Boot
UBOOT_MACHINE = "genio_1200_evk_defconfig"

# libdram
LIBDRAM_BOARD_NAME = "genio-1200-evk"

# OP-TEE
OPTEE_DRAM_SIZE = "0x200000000"

# LK
LK_BOARD_NAME = "mt8395-demo"

MACHINE_FEATURES:append = " alsa bluetooth pci usbgadget usbhost wifi tsn uc-fde"

MACHINEOVERRIDES =. "mt8395-evk:genio-1200-evk:"

# onsemi-firmware
ONSEMI_BOARD_NAME = "MediaTek_Genio"
MACHINE_EXTRA_RRECOMMENDS:append = " \
        onsemi-firmware-ap1302-ar0430 \
        onsemi-firmware-ap1302-ar0830 \
"

# Drivers for external I2C device
MACHINE_EXTRA_RRECOMMENDS:append = " \
        ite-it6510-driver \
        lontium-lt6911-driver \
"
```
